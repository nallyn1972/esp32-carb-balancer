## sdkconfig.defaults
```kconfig
# ESP32-S3 Carburetor Balancer - Default Configuration
#
# This file contains the minimal required configuration for this project.
# Users can override these settings by running 'idf.py menuconfig'
#

# Target Configuration
CONFIG_IDF_TARGET="esp32s3"

# Serial flasher config
CONFIG_ESPTOOLPY_FLASHSIZE_8MB=y
CONFIG_ESPTOOLPY_FLASHFREQ_80M=y
CONFIG_ESPTOOLPY_FLASHMODE_QIO=y

# Partition Table
CONFIG_PARTITION_TABLE_SINGLE_APP=y

# Compiler options
CONFIG_COMPILER_OPTIMIZATION_SIZE=y
CONFIG_COMPILER_OPTIMIZATION_ASSERTIONS_ENABLE=y

# FreeRTOS
CONFIG_FREERTOS_HZ=1000

# ESP System Settings
CONFIG_ESP_MAIN_TASK_STACK_SIZE=8192

# PSRAM Configuration for ESP32-S3
CONFIG_SPIRAM=y
CONFIG_SPIRAM_MODE_OCT=y
CONFIG_SPIRAM_SPEED_80M=y

# LVGL Configuration
CONFIG_LV_USE_FONT_MONTSERRAT_14=y
CONFIG_LV_USE_FONT_MONTSERRAT_18=y
CONFIG_LV_USE_FONT_SUBPX=y
CONFIG_LV_FONT_DEFAULT_MONTSERRAT_14=y

# SPI Configuration
CONFIG_SPI_MASTER_ISR_IN_IRAM=y

# Log output
CONFIG_LOG_DEFAULT_LEVEL_INFO=y
CONFIG_LOG_MAXIMUM_LEVEL_VERBOSE=y

# Component config
CONFIG_FREERTOS_ENABLE_BACKWARD_COMPATIBILITY=y
```
